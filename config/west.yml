## config/west.yml
```yaml
manifest:
  remotes:
    - name: zmkfirmware
      url-base: https://github.com/zmkfirmware
    - name: caksoylar
      url-base: https://github.com/caksoylar
    - name: replicaJunction
      url-base: https://github.com/replicaJunction
  projects:
    - name: zmk
      remote: replicaJunction
      revision: main
      import: app/west.yml
  self:
    path: config
```
